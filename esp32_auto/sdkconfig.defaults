## esp32_auto/sdkconfig.defaults
```kconfig
# ESP32 Wireless Android Auto Dongle Configuration

CONFIG_ESP32S3_DEFAULT_CPU_FREQ_240=y
CONFIG_ESP_DEFAULT_CPU_FREQ_MHZ=240

# Wi-Fi Configuration
CONFIG_ESP32_WIFI_SW_COEXIST_ENABLE=y
CONFIG_ESP32_WIFI_SOFTAP_BEACON_TIMEOUT=1000
CONFIG_ESP_WIFI_SCAN_TIME=200

# Bluetooth Configuration
CONFIG_BT_ENABLED=y
CONFIG_BT_BLE_ENABLED=y
CONFIG_BTDM_CONTROLLER_MODEM_ONLY=y
CONFIG_BT_CTRL_MODEM_SLEEP=y

# FreeRTOS Configuration
CONFIG_FREERTOS_HZ=1000
CONFIG_FREERTOS_TASK_STACK_DEPTH=2048

# Memory Configuration
CONFIG_ESP32S3_SPIRAM_SUPPORT=y
CONFIG_SPIRAM=y
CONFIG_SPIRAM_MODE_QUAD=y
CONFIG_SPIRAM_SPEED_80M=y

# Logging Configuration
CONFIG_LOG_DEFAULT_LEVEL_INFO=y
CONFIG_LOG_MAXIMUM_LEVEL=3
CONFIG_LOG_COLORS=y

# USB Configuration (ESP32-S3)
CONFIG_USB_OTG_SUPPORTED=y
CONFIG_USB_ENABLED=y

# Network Configuration
CONFIG_LWIP_IPV4=y
CONFIG_LWIP_TCP_KEEPALIVE=y
CONFIG_LWIP_DNS_SUPPORT_MDNS_QUERIES=y
```
